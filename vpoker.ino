#include <font4x6.h>
#include <font6x8.h>
#include <font8x8.h>
#include <font8x8ext.h>
#include <fontALL.h>

/*
 * Arduino TV Poker v1.0 by Justin Roeder
 * Poker hand checker script by ProgrammingLogic.com
 * Coin Acceptor https://www.adafruit.com/product/787
 */
#include <EEPROM.h>
#include <TVout.h>
#include <video_gen.h>
#define default_credits -10// set to a negative number to enable coin acceptor
const long saved_game_tag=777;//to erase saved game change this number to anything else
struct SavedGameData{
  long tag;//Used to tell if the game has been saved
  byte bet;//last bet
  long credits; //saved game credits
};
int mode=0;
const char faces[14] = "A23456789TJQKJ";
const char suits[4] = "abcd";
bool panelLights[7]={true,true,false,false,false,false,false};
int blinkState=0;
TVout TV;
int selGame=5;/* defines the default game
0 - none
1 - Jacks or better
2 - double bonus poker
3 - joker poker
4 - double double bonus poker
*/
bool Jackpot,paid,busy,gameStarted;
PROGMEM const unsigned char CONFIRM_CASH_OUT[]={
  128,96,
  0xFF,0xFE,0x00,0x00,0x00,0x00,0x00,0x00,0x00,0x0F,0xFF,0xFF,0xFF,0xFF,0xFF,0xFF,
0xFF,0xFF,0x00,0x00,0x00,0x00,0x00,0x01,0xFF,0xFF,0xFF,0xFF,0xFF,0xFF,0xFF,0xFF,
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0x80,0x00,0x00,0x00,0x00,0x00,0x00,0x00,0x00,0x0F,0xFF,0xFF,0xFF,0xFF,0xFF,0xFF
};
PROGMEM const unsigned char ICON_JACKS_OR_BETTER[]={
  128,96,
0x00,0x00,0x00,0x00,0x00,0x00,0x00,0x00,0x00,0x00,0x00,0x00,0x00,0x00,0x00,0x00,
0x00,0x00,0x00,0x00,0x00,0x00,0x00,0x00,0x00,0x00,0x00,0x00,0x00,0x00,0x00,0x00,
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0x00,0x00,0x00,0x00,0x00,0x00,0x00,0x00,0x00,0x00,0x00,0x07,0xE0,0x3D,0x3F,0xF0,

};

PROGMEM const unsigned char suitFont[] = {
10,12,0x61,
0x00,0x00,
0x00,0x00,
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0x00,0x00,
//clubs
0x00,0x00,
0x00,0x00,
0x08,0x00,
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0x18,0x00,
//diamonds
0x00,0x00,
0x00,0x00,
0x00,0x00,
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0x00,0x00,
//hearts
0x00,0x00,
0x08,0x00,
0x1C,0x00,
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0x00,0x00,
//spades
};
SavedGameData saved;
class Card{
    public:
    bool hold;
    int suit;
    int rank;
};
Card playerHand[5]; 
PROGMEM const unsigned char jackpot1[] ={
  128,96,
  0xFF,0xFF,0xFF,0xFF,0xFF,0xFF,0xFF,0xFF,0xFF,0xFF,0xFF,0xFF,0xFF,0xFF,0xFF,0xFF,
0x00,0x00,0x00,0x00,0x00,0x00,0x00,0x00,0x00,0x00,0x00,0x00,0x00,0x00,0x00,0x00,
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0x00,0x00,0x00,0x00,0x00,0x00,0x00,0x00,0x00,0x00,0x00,0x00,0x00,0x00,0x00,0x00
};
PROGMEM const unsigned char ICON_DOUBLE_BONUS[] ={
  128,96,0x00,0x00,0x00,0x00,0x00,0x00,0x00,0x00,0x00,0x00,0x00,0x00,0x00,0x00,0x00,0x01,
0x00,0x00,0x00,0x00,0x00,0x00,0x00,0x00,0x00,0x00,0x00,0x00,0x00,0x00,0x00,0x01,
0x00,0x00,0x00,0x00,0x00,0x00,0x00,0x00,0x00,0x00,0x00,0x00,0x00,0x00,0x00,0x01,
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0x00,0x00,0x00,0x00,0x00,0x00,0x00,0x00,0x00,0x00,0x00,0x00,0x00,0x00,0x00,0x01
};
PROGMEM const unsigned char jackpot2[] ={
  128,96,0xFF,0xFF,0xFF,0xFF,0xFF,0xFF,0xFF,0xFF,0xFF,0xFF,0xFF,0xFF,0xFF,0xFF,0xFF,0xFF,
0x00,0x00,0x00,0x00,0x00,0x00,0x00,0x00,0x00,0x00,0x00,0x00,0x00,0x00,0x00,0x01,
0x00,0x00,0x00,0x00,0x00,0x00,0x00,0x00,0x00,0x00,0x00,0x00,0x00,0x00,0x00,0x01,
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0x00,0x0F,0xFF,0xFF,0xFF,0xFF,0xFF,0xFF,0xFF,0xFF,0xFF,0xFF,0xFF,0xFF,0xFF,0xFF
};
PROGMEM const unsigned char ICON_JOKER_POKER[]=
{
  128,96,0x00,0x00,0x00,0x00,0x00,0x00,0x00,0x00,0x00,0x00,0x00,0x00,0x00,0x00,0x00,0x00,
0x00,0x00,0x00,0x00,0x00,0x00,0x00,0x00,0x00,0x00,0x00,0x00,0x00,0x00,0x00,0x00,
0x00,0x00,0x00,0x00,0x00,0x00,0x00,0x00,0x00,0x00,0x00,0x00,0x00,0x00,0x00,0x00,
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0x00,0x00,0x00,0x00,0x00,0x00,0x00,0x00,0x00,0x00,0x00,0x00,0x00,0x00,0x00,0x00,
};
PROGMEM const unsigned char jackpot4[] ={
  128,96,
  0x00,0x00,0x00,0x00,0x00,0x00,0x00,0x00,0x00,0x00,0x00,0x00,0x00,0x00,0x00,0x00,
0xFF,0xFF,0xFF,0xFF,0xFF,0xFF,0xFF,0xFF,0xFF,0xFF,0xFF,0xFF,0xFF,0xFF,0xFF,0xFF,
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0xFF,0xFF,0xFF,0xFF,0xFF,0xFF,0xFF,0xFF,0xFF,0xFF,0xFF,0xFF,0xFF,0xFF,0xFF,0xFF
};
PROGMEM const unsigned char jackpot3[] ={
  128,96,0xFF,0xFF,0xFF,0xFF,0xFF,0xFF,0xFF,0xFF,0xFF,0xFF,0xFF,0xFF,0xFF,0xFF,0xFF,0xFF,
0xFF,0xFF,0xFF,0xFF,0xFF,0xFF,0xFF,0xFF,0xFF,0xFF,0xFF,0xFF,0xFF,0xFF,0xFF,0xFF,
0x80,0x00,0x00,0x00,0x00,0x00,0x00,0x00,0x00,0x00,0x00,0x00,0x00,0x00,0x00,0x00,
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0x80,0x00,0x00,0x00,0x00,0x00,0x00,0x00,0x00,0x00,0x00,0x00,0x00,0x00,0x00,0x00
};

PROGMEM const unsigned char ICON_ACES_AND_EIGHTS[] ={
  128,96,
  0x00,0x00,0x00,0x00,0x00,0x00,0x00,0x00,0x00,0x00,0x00,0x00,0x00,0x00,0x00,0x00,
0x00,0x00,0x00,0x00,0x00,0x00,0x00,0x00,0x00,0x00,0x00,0x00,0x00,0x00,0x00,0x00,
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0x00,0x00,0x00,0x00,0x00,0x00,0x00,0x00,0x00,0x00,0x00,0x00,0x00,0x00,0x00,0x00,

};
PROGMEM const unsigned char ICON_DOUBLE_DOUBLE_BONUS[] ={
  128,96,
  0x00,0x00,0x00,0x00,0x00,0x00,0x00,0x00,0x00,0x00,0x00,0x00,0x00,0x00,0x00,0x00,
0x00,0x00,0x00,0x00,0x00,0x00,0x00,0x00,0x00,0x00,0x00,0x00,0x00,0x00,0x00,0x00,
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0x00,0x00,0x00,0x00,0x00,0x00,0x00,0x00,0x00,0x00,0x00,0x00,0x00,0x00,0x00,0x00
};
void executeJackpot(){
  switch((millis()%1000)/250){
    case 0:TV.bitmap(0,0,jackpot1);break;
    case 1:TV.bitmap(0,0,jackpot2);break;
    case 2:TV.bitmap(0,0,jackpot3);break;
    case 3:TV.bitmap(0,0,jackpot4);break;
  }
}
int compareCards(const void *card1, const void *card2){
    return (*(Card *)card1).rank - (*(Card *)card2).rank;
}
int evaluateHand(Card hand[]){
            qsort(hand,5,sizeof(Card),compareCards);
            int straight,flush,three,four,full,jacksOrBetter,pairs;
            int k,dbFour;  
            Card jokerHand[5];
            int jokerWin=1;
    bool bthree;
    bool btwo;
    bthree=btwo=false;
            dbFour=-1;
            jacksOrBetter=straight = flush = three = four = full = pairs = 0;
            k = 0;
            int ofAKind=hand[0].rank;
            int extraCard=-1;
            int rankCount[14];
            bool five=true;
for(int i=0;i<5;i++)five=five&&hand[i].rank+hand[i].suit==0;
if(five)return -1;five=true;
            for(int i=1;i<5;i++)five=five&&(hand[i].rank==ofAKind);
            if(five)return 14;
          for(int j=0;j<5;j++)rankCount[hand[j].rank]++;
          for(int j=0;j<13;j++)if(rankCount[j]==1)extraCard=j;
for(int i=0;i<13;i++)switch(rankCount[i]){
  case 2:btwo=true;break;
  case 3:bthree=true;break;
}
         /*checks for flush*/
            while (k<4&&hand[k].suit==hand[k+1].suit)
                k++;
            if (k==4){
                flush = 1;
            }
            if(flush&&hand[0].rank==0&&hand[1].rank==9&&hand[2].rank==10&&hand[3].rank==11&&hand[4].rank==12)
            return 10;//royal flush
            /* checks for straight*/
            k=0;
            while (k<4&&hand[k].rank==hand[k+1].rank-1)
                k++;
            if (k==4){
                straight = 1;
            }
            /* checks for fours */
            for (int i=0;i<2;i++){
                k = i;
                while (k<i+3&&hand[k].rank==hand[k+1].rank){
                    k++;ofAKind=hand[k].rank;
                    if(selGame==2||selGame==4)
                    dbFour=hand[k].rank;
                }
                if (k==i+3){
                    four = 1;
                }else dbFour=-1;
            }

            /*checks for threes and fullhouse*/
            
            if (!four){
                for (int i=0;i<3;i++){
                    k = i;
                    while (k<i+2&&hand[k].rank==hand[k+1].rank){
                        k++;
                    }
                    if (k==i+2){
                        three = 1;
                        if (i==0){
                            if (hand[3].rank==hand[4].rank){
                                full=1;
                        }
                        else if(i==1){
                            if (hand[0].rank==hand[4].rank){
                                full=1;}            }
                        else{
                            if (hand[0].rank==hand[1].rank){
                         
                                full=1;
                            }
                        }
                    }
                }
            }
            }
            if (straight&&flush){
                return 9;
            }
            else if(four){
              if(selGame==4)
                switch(dbFour){
                  case 0:
                  case 7:return 13;
                  case 6:return 12;
                  default:return 11;
                  case -1:;
                }
          if(selGame==5){
         switch(dbFour){
          case 0:if(hand[4].rank<4)return 8;return 11;
          case 1:
          case 2:
          case 3:if(extraCard==0||extraCard<4)return 11;return 12;
          case 4:
          case 5:
          case 6:
          case 7:
          case 8:
          case 9:
          case 10:
          case 11:
          case 12:return 13;
         }
         }
              if(selGame==2)
              switch(dbFour){
                case 0:return 11;
                case 1:
                case 2:
                case 3:return 12;
                case 4:
                case 5:
                case 6:
                case 7:
                case 8:
                case 9:
                case 10:
                case 11:
                case 12:return 13;
              }
              if(hand[4].rank==13)return 14;
                return 8;
            }
            else if(full&&btwo&&bthree)
                return 7;
            else if(flush)
                return 6;
            else if(straight)
                return 5;
            else if(three){
            if(hand[4].rank==13)return 7;
                return 4;
            }
            /* checks for pairs*/
            for (k=0;k<4;k++)
                if (hand[k].rank==hand[k+1].rank){
                  if(hand[k].rank==0||hand[k].rank>9)jacksOrBetter++;
                    pairs++;
                  }
            if (pairs==2)
            
                return 3;
            else if(pairs){
              if(hand[4].rank==13)return 4; 
              if(jacksOrBetter==1&&selGame!=3)
                return 2;
               else return 1;
            }
            else{
             if(selGame==3&&hand[4].rank==13){
                for(int i=0;i<4;i++){  
                for(int j=0;j<13;j++){
                  for(int l=0;l<4;l++){
                    jokerHand[l].suit=hand[l].suit;
                    jokerHand[l].rank=hand[l].rank;
                  }
                  jokerHand[4].suit=i;
                  jokerHand[4].rank=j;
                  jokerWin=max(jokerWin,evaluateHand(jokerHand));
                }
                }
             return jokerWin;
             }
             return 0;
            }
}
byte cardDeck[10];
byte suitFromCard(byte card){
  return card/0x10;
}
byte faceFromCard(byte card){
  return card&0x0f;
}
word getPayout(int handType,int selGame){
 if(selGame==1)
 switch(handType){
  case 2:return 1;
  case 3:return 2; 
  case 4:return 3;
  case 5:return 4;
  case 6:return 6;
  case 7:return 9;
  case 8:return 25;
  case 9:return 50;
  case 10:if(saved.bet==5)return 800; else return 250;
}if(selGame==3)
 switch(handType){
  case 3:return 1; 
  case 4:return 2;
  case 5:return 5;
  case 6:return 6;
  case 7:return 10;
  case 8:return 20;
  case 9:return 50;
  case 10:return 1000;
  case 14:return 100;
  case 15:return 50;
}
 if(selGame==2)
 switch(handType){
  case 2:return 1;
  case 3:return 1;
  case 4:return 3;
  case 5:return 5;
  case 6:return 7;
  case 7:return 10;
  case 9:return 50;
  case 10:if(saved.bet==5)return 800; else return 250;
  case 11:return 160;
  case 12:return 80;
  case 13:return 50;
}
 if(selGame==5)
 switch(handType){
  case 2:return 1;
  case 3:return 1;
  case 4:return 3;
  case 5:return 4;
  case 6:return 6;
  case 7:return 10;
  case 9:return 50;
  case 10:if(saved.bet==5)return 800; else return 250;
  case 11:return 160;
  case 12:return 80;
  case 13:return 50;
  case 8:return 400;
}
 if(selGame==4)
 switch(handType){
  case 2:return 1;
  case 3:return 2;
  case 4:return 3;
  case 5:return 4;
  case 6:return 5;
  case 7:return 8;
  case 9:return 50;
  case 10:if(saved.bet==5)return 800; else return 250;
  case 11:return 25;
  case 12:return 50;
  case 13:return 80;
}
return 0;
}
byte makeCard(byte face,byte suit){
  return face+(suit*0x10);
}
bool isCardUsed(byte card){
  for(int i=0;i<10;i++)if(card==cardDeck[i])return true;
  return false;
}
bool holdButtons[5];
bool betOne,betMax,cashOut,dealDraw;
void repaint(){
 if(!gameStarted)return;
  TV.clear_screen();
  TV.select_font(font6x8);
 int winner=0;
  if(selGame>0){
 winner=evaluateHand(playerHand);
 if(winner>-1)
    for(int i=0;i<5;i++){
     TV.set_cursor(20*i+4,0);
     if(playerHand[i].rank<14){
     TV.print(faces[playerHand[i].rank]);
    if(playerHand[i].rank<13){
      TV.select_font(suitFont);
  TV.print(suits[playerHand[i].suit]);
    }else TV.print("oker");
    TV.select_font(font6x8);
    TV.set_cursor(20*i+4,25);
  if(playerHand[i].hold)TV.print("Hol");else TV.print("   ");}}
 /* else{
  TV.select_font(suitFont);
    TV.print("e");
    TV.select_font(font6x8);
    TV.print("Ho ");
  }*/
  for(int i=0;i<2;i++)
  TV.println();
if(saved.credits<1){
  TV.println("Game Over");
  delay(5000);
  saved.credits=default_credits;
  if(default_credits<1){
    saved.credits=0;
    paid=false;
  }
gameStarted=false;
  return;
}}
TV.print("$");
TV.print(saved.credits);
TV.print(" Bet: ");
TV.print(saved.bet,DEC);
TV.println();
if(selGame>0&&busy)
switch(winner){
  case 0:TV.print("Nothing");break;
  case 1:TV.print("Pair(not good enough)");break;
  case 2:TV.print("Jacks or better $");TV.print(saved.bet,DEC);break;
  case 3:TV.print("Two Pairs $");TV.print(saved.bet*getPayout(winner,selGame),DEC);break;
  case 4:TV.print("3 of a kind $");
  TV.print(saved.bet*getPayout(winner,selGame),DEC);break;
  case 5:TV.print("Straight $");TV.print(saved.bet*getPayout(winner,selGame),DEC);break;
  case 7:TV.print("Full House $");TV.print(saved.bet*getPayout(winner,selGame),DEC);break;
 case 13:
 case 12:
 case 11:
  case 8:TV.print("4 of a kind $");TV.print(saved.bet*getPayout(winner,selGame),DEC);break;
  case 6:TV.print("Flush $");TV.print(saved.bet*getPayout(winner,selGame),DEC);break;
  case 9:TV.print("Straight Flush $");TV.print(saved.bet*getPayout(winner,selGame),DEC);break;
case 14:TV.print("5 of a kind $");TV.print(saved.bet*getPayout(winner,selGame),DEC);break;
case 10:TV.print("Royal Flush $");TV.print(saved.bet*getPayout(winner,selGame),DEC);break;
case 15:TV.print("Wild Royal Flush $");TV.print(saved.bet*getPayout(winner,selGame),DEC);break;
}
TV.println();
if(mode%2==1&&winner>1&&!busy)TV.println("You won!");
if(mode%2==1&&winner<2&&!busy)TV.println("You lose!");
}
void newHand(){
  digitalWrite(A1,LOW);
  digitalWrite(A2,LOW);
  digitalWrite(A3,LOW);
  digitalWrite(A4,LOW);
  digitalWrite(A5,LOW);
  for(int i=1;i<7;i++)panelLights[i]=false;
  panelLights[0]=true;
  for(int i=0;i<10;i++)cardDeck[i]=255;
int cardCount=0;
while(cardCount<10){
  byte suit=random(4);
  byte face=random(13);
  if(selGame==3){face=random(14);if(face==13)suit=4;}
  byte c=makeCard(face,suit);
  if(!isCardUsed(c)){cardDeck[cardCount]=c;
    if(cardCount<5){playerHand[cardCount].suit=suit;playerHand[cardCount].rank=face;
  playerHand[cardCount].hold=false;}
  cardCount++;
  }
}
busy=true;
mode=1;
repaint();
}void draw(){
  for(int i=0;i<5;i++){
if(!playerHand[i].hold){playerHand[i].rank=faceFromCard(cardDeck[i+5]);
playerHand[i].suit=suitFromCard(cardDeck[i+5]);}playerHand[i].hold=false;}
mode=0;
busy=false;
repaint();
panelLights[1]=(saved.bet>=saved.credits);
}
void setup() {
  // put your setup code here, to run once:
  saved.bet=1;
  saved.credits=default_credits;
  if(default_credits>0){
  EEPROM.get(21,saved);
  if(saved.tag!=saved_game_tag){
  saved.tag=saved_game_tag;
  EEPROM.put(21,saved);
  }
  }else{
    delay(750);
   saved.credits=0;
    pinMode(1,INPUT_PULLUP);
  }
  pinMode(8,INPUT_PULLUP);//bet one button
  pinMode(10,INPUT_PULLUP);//deal/draw button
  pinMode(11,INPUT_PULLUP);//bet max button
  pinMode(12,INPUT_PULLUP);//cash out button
  pinMode(13,OUTPUT);//bet button and cash out lights  
  int randomId=0;
  for(int i=A0;i<=A5;i++)
randomId+=analogRead(i)-randomId;
randomSeed(randomId);
  pinMode(A1,OUTPUT);
  digitalWrite(A1,LOW);
  pinMode(A2,OUTPUT);
  digitalWrite(A2,LOW);
    pinMode(A3,OUTPUT);
  digitalWrite(A3,LOW);
    pinMode(A4,OUTPUT);
  digitalWrite(A4,LOW);
  pinMode(A5,OUTPUT);
  digitalWrite(A5,LOW);
  //A1-A5 hold/cancel lights
for(int i=2;i<7;i++){//hold buttons are pins 2-6
 pinMode(i,INPUT_PULLUP);
}
TV.begin(_NTSC); 
TV.select_font(font6x8);
//randomSeed(analogRead(A0));
pinMode(A0,OUTPUT);//deal/draw light
for(int i=0;i<5;i++){playerHand[i].hold=false;}
switch(selGame){
    case 1:TV.bitmap(0,0,ICON_JACKS_OR_BETTER);break;
    case 2:TV.bitmap(0,0,ICON_DOUBLE_BONUS);break;
    case 3:TV.bitmap(0,0,ICON_JOKER_POKER);break;
  case 4:TV.bitmap(0,0,ICON_ACES_AND_EIGHTS);break;
  case 5:TV.bitmap(0,0,ICON_DOUBLE_DOUBLE_BONUS);break;
  }
saved.credits=5;
}
void toggleLights(){
  if(millis()%2000>1000){
if(panelLights[0])digitalWrite(A0,blinkState);
if(panelLights[1])digitalWrite(13,blinkState);
if(panelLights[2])digitalWrite(A1,blinkState);
if(panelLights[3])digitalWrite(A2,blinkState);
if(panelLights[4])digitalWrite(A3,blinkState);
if(panelLights[5])digitalWrite(A4,blinkState);
if(panelLights[6])digitalWrite(A5,blinkState);
blinkState ^= HIGH;
  }
}
PROGMEM const unsigned char INSERT_COINS[]=
{//Had to use bitmap instead of text, otherwise it crash
  94,23,
  0x00,0x00,0x00,0x00,0x00,0x00,0x00,0x00,0x00,0x00,0x00,0x00,
0x00,0x00,0x00,0x00,0x00,0x00,0x00,0x00,0x00,0x00,0x00,0x00,
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0x00,0x00,0x00,0x00,0x00,0x00,0x00,0x00,0x00,0x00,0x00,0x00,
};
void loop() {
// put your main code here, to run repeatedly:
  if(default_credits<1&&!paid){
  TV.bitmap(0,48,INSERT_COINS);
    // while the coin pin is low (no coin detected), do nothing
  while (! digitalRead(1)) {
    delay(1);
    toggleLights();
  }
  // while the pin is high, we'll track the length with a counter
  uint8_t counter = 0;
  while (digitalRead(1)) {
    delay(1);
    toggleLights();
    counter++;
  }
  if ((counter > 60) || (counter < 20))
      return;
      
  saved.credits=abs(default_credits);
  paid=true;
}
  toggleLights();
  bool holds=false;
  for(int i=2;i<7;i++)holds=(holds||digitalRead(i)==LOW);
  if(digitalRead(10)==LOW&&holds&&gameStarted&&!busy){
    gameStarted=holds=false;
    return;
  }
  if(Jackpot){
    executeJackpot();
  }
  for(int j=0;j<5;j++)
if(!gameStarted&&(digitalRead(2+j)==LOW)){
  selGame++;
  for(int i=0;i<5;i++)  holdButtons[i]=false;
  if(selGame>5)selGame=1;
  switch(selGame){
    case 1:TV.bitmap(0,0,ICON_JACKS_OR_BETTER);break;
    case 2:TV.bitmap(0,0,ICON_DOUBLE_BONUS);break;
    case 3:TV.bitmap(0,0,ICON_JOKER_POKER);break;
  case 4:TV.bitmap(0,0,ICON_ACES_AND_EIGHTS);break;
  case 5:TV.bitmap(0,0,ICON_DOUBLE_DOUBLE_BONUS);break;
  }
  delay(50);
}if(!gameStarted&&digitalRead(10)==LOW){
 dealDraw=false;
 gameStarted=true;
 repaint();
  delay(50);
}
if(mode%2==1&&selGame>0&&busy){
for(int i=0;i<5;i++){
    if(digitalRead(2+i) == LOW){
    holdButtons[i] = true;
  }else{
    if(holdButtons[i]){
      playerHand[i].hold=!playerHand[i].hold;
if(!panelLights[2]&&!panelLights[3]&&!panelLights[4]&&!panelLights[5]&&!panelLights[6])
if(playerHand[i].hold)
switch(i){
  case 0:digitalWrite(A1,HIGH);break;
  case 1:digitalWrite(A2,HIGH);break;
  case 2:digitalWrite(A3,HIGH);break;
  case 3:digitalWrite(A4,HIGH);break;
  case 4:digitalWrite(A5,HIGH);break;
}else switch(i){
  case 0:digitalWrite(A1,LOW);break;
  case 1:digitalWrite(A2,LOW);break;
  case 2:digitalWrite(A3,LOW);break;
  case 3:digitalWrite(A4,LOW);break;
  case 4:digitalWrite(A5,LOW);break;
}
      repaint();
      delay(50);
      holdButtons[i] = false;
    }
  }
  }
}
  if(mode%2==0){
    if(digitalRead(8) == LOW){
    betOne = true;
  }else{
    if(betOne){
      saved.bet++;
      if(saved.bet>min(saved.credits,5))saved.bet=1;
      repaint();
      delay(50);
      betOne = false;
    }
  }
  if(digitalRead(11)==LOW){
    betMax = true;
  }else{
    if(betMax){
      saved.bet=min(5,saved.credits);
      repaint();
      delay(50);
      betMax = false;
    }
  }if(digitalRead(12)==LOW){
    if(saved.credits<1)return;
    cashOut = true;
  }else{
    if(cashOut){
    if(default_credits<1){
      unsigned long n=0;
      TV.bitmap(0,0,CONFIRM_CASH_OUT);while(digitalRead(12)==HIGH&&n<5000){
        delay(1);n++;toggleLights();
      }
       if(n>=5000){
        cashOut=false;return;
       }
        saved.credits=0;paid=cashOut=false;return;
      }
      EEPROM.put(21,saved);
      TV.println("Game saved");
      delay(2500);
      repaint();
      cashOut = false;
    }
  }
  }
    if(digitalRead(10) == LOW&&gameStarted){
      if(Jackpot){
        Jackpot=false;
        for(int i=2;i<7;i++)panelLights[i]=false;
        repaint();
        return;
      }
      if(selGame==0){
        repaint();
        return;
      }
    dealDraw = true;
  }else{
     if(dealDraw){
     switch(mode%2){
        case 0:saved.credits-=saved.bet;if(saved.credits<1){panelLights[0]=panelLights[1]=false;break;}newHand();break;
        case 1:draw();saved.credits+=saved.bet*getPayout(evaluateHand(playerHand),selGame);repaint();if(evaluateHand(playerHand)==10){
          delay(5000);Jackpot=true;for(int i=2;i<7;i++)panelLights[i]=true;dealDraw=false;return;
        }break;
     }
      delay(50);
     dealDraw = false;
    }
  }
}
